/*
Scrolling text display for YFRobot 8x8 Dot Matrix display (controller with dual serial 74HC595 chips)
Author: Andy Qua
Date: 26th April 2015
*/

int dataPin = 11;             // The Serial Data Pin to the Shift Register (SER on board)
int latchPin = 12;             // The Latch Pin to the Shift Register (RCK on board)
int clockPin = 10;             // The Clock Pin to the Shift Register (SRCK on board)

/*
Letters are 8x6 bytes and are in vertical rows
E.g. for A:
  column 1 -> 0x7f = 01111111      Rotated:    XXX
  column 2 -> 0x88 = 10001000                 X   X
  column 3 -> 0x88 = 10001000                 X   X
  column 4 -> 0x88 = 10001000                 X   X
  column 5 -> 0x7f = 01111111                 XXXXX
  column 6 -> 0x00 = 00000000                 X   X
                                              X   X  
                                              X   X  

for B:
  column 1 -> 0xFF = 11111111      Rotated:   XXXX
  column 2 -> 0x91 = 10010001                 X   X
  column 2 -> 0x91 = 10010001                 X   X
  column 2 -> 0x91 = 10010001                 X   X
  column 5 -> 0x6e = 01101110                 XXXX
  column 6 -> 0x00 = 00000000                 X   X
                                              X   X  
                                              XXXX
*/

// Basic alphabet
byte letters[][6] = {
  { 0x7F, 0x88, 0x88, 0x88, 0x7F, 0x00}, //  A
  { 0xFF, 0x91, 0x91, 0x91, 0x6E, 0x00}, //  B
  { 0x7E, 0x81, 0x81, 0x81, 0x42, 0x00}, //  C
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  { 0x00, 0x00, 0x00, 0x00, 0x00, 0x00} // SPACE
};

// character to letter mapping
String letterPositions = "ABCDEFGHIJKLMNOPQRSTUVWXYZabcdefghijklmnopqrstuvwxyz1234567890?! ";

// The database for the text to scroll
byte *textBytes;
int nrLetters = 0;
int columnNumbers[8] = { 1, 2, 4,5,6,7,8 };


void setup()
{
  pinMode(dataPin, OUTPUT);    // Configure Digital Pins
  pinMode(latchPin, OUTPUT);
  pinMode(clockPin, OUTPUT);

  // Text = Hello from AndyQ
  loadString( " Hello from AndyQ  This text scrolls!  " );
}

void loadString( String text )
{
  // Build up byte array
  nrLetters = text.length();
  
  // Allocate memory for byte array
  textBytes = (byte *)malloc(nrLetters * 6 * sizeof(byte));
  int pos = 0;
  for ( int i = 0 ; i < nrLetters ; ++i )
  {
    int chPos = letterPositions.indexOf( text[i] );
    if ( chPos == -1 )
      continue;

    for ( int j = 0 ; j < 6 ; ++j )
    {
      textBytes[pos++] = letters[chPos][j];
    }

  }
}

void loop()
{
  for ( int p = 0 ; p < (nrLetters * 6) ; p++ )
  {
    int columnVal = 0;
    
    // Change repeat to vary the speed of the scrolling text
    for (int repeat = 0; repeat < 50; repeat++ )
    {
      for ( int col = 0 ; col < 8 ; ++col )
      {
        columnVal = textBytes[p + col];
        
        // For some reason, columnNumbers are set sanely (e.g. 1,2,4,8,16,32,64,128)
        // BUT the column values are inverted - so a 1 means off and a 0 is on!
        // so we invert the bits in the rowVal.
        writeOutput(~columnVal, columnNumbers[col]);
      }
    }
  }
}


void writeOutput( int rowVal, int col  )
{
  digitalWrite(latchPin, LOW);                    // Pull latch LOW to send data
  shiftOut(dataPin, clockPin, MSBFIRST, rowVal);  // Send the row data byte
  shiftOut(dataPin, clockPin, MSBFIRST, col);     // Send the column data byte
  digitalWrite(latchPin, HIGH);                   // Pull latch HIGH to finish sending data
}
